#include "hal_data.h"
#include "ecat_def.h"
#include "ecatappl.h"
#include "ecatslv.h"
#include "applInterface.h"
#include "r_fw_up_rz_if.h"
#if (CiA402_SAMPLE_APPLICATION == 1)
#include "cia402appl.h"
#else
#include "sampleappl.h"
#endif
#include "renesashw.h"
//#include "sio_char.h"
#include <stdio.h>
#include "log.h"

#define CURRENT_LOG_LEVEL   LOG_LEVEL_DEBUG

#define RZN2_APP1_VERSION   ("0.1.0")

FSP_CPP_HEADER
void R_BSP_WarmStart(bsp_warm_start_event_t event)
BSP_PLACE_IN_SECTION(".warm_start");
FSP_CPP_FOOTER
void handle_error(fsp_err_t err);


/*
    R_SCI_B_UART_Open(&g_uart9_ctrl, &g_uart9_cfg);
    printf("\nToolchain ver:%s\n", __VERSION__);
    printf("date:%s\ntime:%s\nfile:%s\nfunc:%s,line:%d\nhello world!\n", __DATE__, __TIME__, __FILE__, __FUNCTION__, __LINE__);
 */
#define PRINTF  1   //only need change g_uart9_ctrl, uartcallback=NULL
#if PRINTF
#include <stdio.h>
static void USR_SCI_UART_Write (uart_ctrl_t * const p_api_ctrl, uint8_t const * const p_src, uint32_t const bytes);
static void USR_SCI_UART_Write (uart_ctrl_t * const p_api_ctrl, uint8_t const * const p_src, uint32_t const bytes)
{
    uint32_t i;
#if defined(R_SCI_B_UART_CFG_H_)  //RA6T2 RA8T2
    sci_b_uart_instance_ctrl_t * p_ctrl = (sci_b_uart_instance_ctrl_t *) p_api_ctrl;
#else
    sci_uart_instance_ctrl_t * p_ctrl = (sci_uart_instance_ctrl_t *) p_api_ctrl;
#endif//#if defined(R_SCI_B_UART_CFG_H_)
    uint8_t *data  = (uint8_t *)p_src;
    for(i = 0; i < bytes; i++)
    {
#if defined(R_SCI_B_UART_CFG_H_)  //RA6T2 RA8T2
        p_ctrl->p_reg->TDR_b.TDAT = *data;
        while(p_ctrl->p_reg->CSR_b.TDRE == 0);
#else

#if defined(_RENESAS_RA_)  //RA excluded RA6T2 RA8T2
        p_ctrl->p_reg->TDR_b.TDR = *data;
        while(p_ctrl->p_reg->SSR_b.TDRE == 0);
#elif defined(_RENESAS_RZN_) || defined(_RENESAS_RZT_) //RZN RZT
        p_ctrl->p_reg->TDR_b.TDAT = *data;
        while(p_ctrl->p_reg->CSR_b.TDRE == 0);
#endif//#if defined(_RENESAS_RA_)
#endif//#if defined(R_SCI_B_UART_CFG_H_)
        data++;
    }
}
#if defined __GNUC__ && !defined __clang__  //e2+gcc
int _write(int fd, char *pBuffer, int size);
int _write(int fd, char *pBuffer, int size)
{
    (void)fd;
    USR_SCI_UART_Write(&g_uart0_ctrl, (uint8_t *)pBuffer, (uint32_t)size);

    return size;
}
#elif defined __llvm__ && defined __clang__ //e2+llvm
int user_write(char ptr, FILE* file)
{
    (void)(file);
    USR_SCI_UART_Write(&g_uart9_ctrl, (uint8_t * const)(&ptr), 1U);
    return 0;
}
/* Redirect sdtio as per https://github.com/picolibc/picolibc/blob/main/doc/os.md */
static FILE __stdio = FDEV_SETUP_STREAM(user_write, NULL, NULL, _FDEV_SETUP_WRITE);
FILE *const stdin = &__stdio;
__strong_reference(stdin, stdout);
__strong_reference(stdin, stderr);

#elif defined __ICCARM__    //iar
#include <yfuns.h>
#if __VER__ < 8000000
  _STD_BEGIN
#endif
  #pragma module_name = "?__write"
size_t __write(int handle, const unsigned char * buffer, size_t size)
{
      USR_SCI_UART_Write(&g_uart9_ctrl, (uint8_t *)pBuffer, (uint32_t)size);
}
#if __VER__ < 8000000
  _STD_END
#endif
#else   //keil
int fputc(int ch, FILE *f)
{
    (void)f;
    USR_SCI_UART_Write(&g_uart9_ctrl, (uint8_t *)&ch, 1);

    return ch;
}
#endif//#if defined __GNUC__ && !defined __clang__
#endif//#if PRINTF


/*******************************************************************************************************************//**
 * main() is generated by the FSP Configuration editor and is used to generate threads if an RTOS is used.  This function
 * is called by main() when no RTOS is used.
 **********************************************************************************************************************/
void hal_entry(void)
{
#if 0
    /* TODO: add your own code here */
    __enable_irq();

    g_uart0.p_api->open(g_uart0.p_ctrl, g_uart0.p_cfg);
    g_uart0.p_api->write(g_uart0.p_ctrl, (uint8_t const *)"App start!\n", strlen("App start!\n"));
    R_BSP_SoftwareDelay(100, BSP_DELAY_UNITS_MILLISECONDS);

    printf("date:%s\ntime:%s\nfile:%s\nfunc:%s,line:%d\nhello world!\n", __DATE__, __TIME__, __FILE__, __FUNCTION__, __LINE__);

    float PI = 3.1415926f;
    printf("PI=%f\n", PI);
    printf("%s\n", FSP_VERSION_BUILD_STRING);

    while (1)
    {
        /* Delay */
        R_BSP_SoftwareDelay(1000, BSP_DELAY_UNITS_MILLISECONDS);
        g_uart0.p_api->write(g_uart0.p_ctrl, (uint8_t const *)"App running!\n", strlen("App running!\n"));
    }
#endif

    fsp_err_t err;

    /* Open the transfer instance with initial configuration. */
    err = R_SCI_UART_Open(&g_uart0_ctrl, &g_uart0_cfg);
    handle_error(err);
    g_uart0.p_api->write(g_uart0.p_ctrl, (uint8_t const *)"App start!\n", strlen("App start!\n"));
    R_BSP_SoftwareDelay(100, BSP_DELAY_UNITS_MILLISECONDS);
    LOG_INFO("App start! %s\n", RZN2_APP1_VERSION);

    LOG_INFO("date:%s\ntime:%s\nfile:%s\nfunc:%s,line:%d\nhello world!\n", __DATE__, __TIME__, __FILE__, __FUNCTION__, __LINE__);

    float PI = 3.1415926f;
    LOG_INFO("PI=%f\n", PI);
    LOG_INFO("%s\n", FSP_VERSION_BUILD_STRING);

    /* Open the QSPI instance */
    err = R_XSPI_QSPI_Open(&g_qspi0_ctrl, &g_qspi0_cfg);
    handle_error(err);

#if defined(BOARD_RZT2M_RSK) && (BSP_CFG_CORE_CR52 == 1)
    /* Open the shared memory driver. */
    err = R_SHARED_MEMORY_Open(&g_shared_memory0_ctrl, &g_shared_memory0_cfg);
    handle_error(err);
#endif

#if defined(BOARD_RZT2L_RSK)
    ethercat_ssc_port_extend_cfg_t * p_ethercat_ssc_port_ext_cfg;
    ether_phy_instance_t * p_ether_phy0;
    ether_phy_instance_t * p_ether_phy1;

    p_ethercat_ssc_port_ext_cfg = (ethercat_ssc_port_extend_cfg_t *)gp_ethercat_ssc_port->p_cfg->p_extend;
    p_ether_phy0 = (ether_phy_instance_t *)p_ethercat_ssc_port_ext_cfg->p_ether_phy_instance[0];
    p_ether_phy1 = (ether_phy_instance_t *)p_ethercat_ssc_port_ext_cfg->p_ether_phy_instance[1];
#endif

    /* Initialize EtherCAT SSC Port */
    err = RM_ETHERCAT_SSC_PORT_Open(gp_ethercat_ssc_port->p_ctrl, gp_ethercat_ssc_port->p_cfg);
    handle_error(err);

#if defined(BOARD_RZT2L_RSK)
    /* RZ/T2L RSK board needs starting auto negotiation by phy register access */
    R_ETHER_PHY_StartAutoNegotiate(p_ether_phy0->p_ctrl);
    R_ETHER_PHY_StartAutoNegotiate(p_ether_phy1->p_ctrl);
#endif

    /* Enable interrupt */
    __asm volatile ("cpsie i");

    /* Print that the EtherCAT Sample starts */
#if defined(BOARD_RZT2M_RSK)
#if (BANK == 0)
    char start_messege[] = "RZ/T2M EtherCAT sample program starts on BANK0.\r\n";
#elif (BANK == 1)
    char start_messege[] = "RZ/T2M EtherCAT sample program starts on BANK1.\r\n";
#endif
#endif
#if defined(BOARD_RZT2L_RSK)
#if (BANK == 0)
    char start_messege[] = "RZ/T2L EtherCAT sample program starts on BANK0.\r\n";
#elif (BANK == 1)
    char start_messege[] = "RZ/T2L EtherCAT sample program starts on BANK1.\r\n";
#endif
#endif
#if defined(BOARD_RZN2L_RSK)
#if (BANK == 0)
    char start_messege[] = "RZ/N2L EtherCAT sample program starts on BANK0.\r\n";
#elif (BANK == 1)
    char start_messege[] = "RZ/N2L EtherCAT sample program starts on BANK1.\r\n";
#endif
#endif
    /* Send massage to PC by UART communication. */
    LOG_INFO("%s",start_messege);

    /* Initilize the stack */
    MainInit();
#if (CiA402_SAMPLE_APPLICATION == 1)
    /* Initialize axis structures */
    CiA402_Init();
#endif

    /* Create basic mapping */
    APPL_GenerateMapping(&nPdInputSize,&nPdOutputSize);
    /* Set stack run flag */
    bRunApplication = TRUE;

    /* Execute the stack */
    while(bRunApplication == TRUE)
    {
        MainLoop();
    }
#if (CiA402_SAMPLE_APPLICATION == 1)
    /* Remove all allocated axes resources */
    CiA402_DeallocateAxis();
#endif
    /* Close SSC Port */
    RM_ETHERCAT_SSC_PORT_Close(gp_ethercat_ssc_port->p_ctrl);

}
void handle_error(fsp_err_t err)
{
    FSP_PARAMETER_NOT_USED(err);
}

volatile bool uartTxCompleteFlg = 0;
void user_uart_callback(uart_callback_args_t *p_args)
{
    if(p_args->event == UART_EVENT_TX_COMPLETE)
    {
        uartTxCompleteFlg = 1;
    }
}
/*******************************************************************************************************************//**
 * This function is called at various points during the startup process.  This implementation uses the event that is
 * called right before main() to set up the pins.
 *
 * @param[in]  event    Where at in the start up process the code is currently at
 **********************************************************************************************************************/
void R_BSP_WarmStart(bsp_warm_start_event_t event)
{
    if (BSP_WARM_START_RESET == event)
    {
        /* Pre clock initialization */
    }

    if (BSP_WARM_START_POST_C == event)
    {
        /* C runtime environment and system clocks are setup. */

        /* Configure pins. */
        R_IOPORT_Open (&g_ioport_ctrl, &g_bsp_pin_cfg);
    }
}
